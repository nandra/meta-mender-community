## meta-mender-radxa/conf/layer.conf
```bitbake
# Copyright 2018 Northern.tech AS

# We have a conf and classes directory, add to BBPATH
BBPATH .= ":${LAYERDIR}"

# We have recipes-* directories, add to BBFILES
BBFILES += "${LAYERDIR}/recipes-*/*/*.bb \
	${LAYERDIR}/recipes-*/*/*.bbappend"

BBFILE_COLLECTIONS += "mender-radxa"
BBFILE_PATTERN_mender-radxa = "^${LAYERDIR}/"
BBFILE_PRIORITY_mender-radxa = "10"
```
